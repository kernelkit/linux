## Documentation/devicetree/bindings/net/ti,dp83822.yaml
```yaml
# SPDX-License-Identifier: (GPL-2.0+ OR BSD-2-Clause)
# Copyright (C) 2020 Texas Instruments Incorporated
%YAML 1.2
---
$id: "http://devicetree.org/schemas/net/ti,dp83822.yaml#"
$schema: "http://devicetree.org/meta-schemas/core.yaml#"

title: TI DP83822 ethernet PHY

maintainers:
  - Dan Murphy <dmurphy@ti.com>

description: |
  The DP83822 is a low-power, single-port, 10/100 Mbps Ethernet PHY. It
  provides all of the physical layer functions needed to transmit and receive
  data over standard, twisted-pair cables or to connect to an external,
  fiber-optic transceiver. Additionally, the DP83822 provides flexibility to
  connect to a MAC through a standard MII, RMII, or RGMII interface

  Specifications about the Ethernet PHY can be found at:
    http://www.ti.com/lit/ds/symlink/dp83822i.pdf

allOf:
  - $ref: "ethernet-phy.yaml#"

properties:
  reg:
    maxItems: 1

  ti,link-loss-low:
    type: boolean
    description: |
       DP83822 PHY in Fiber mode only.
       Sets the DP83822 to detect a link drop condition when the signal goes
       high.  If not set then link drop will occur when the signal goes low.
       This property is only applicable if the fiber mode support is strapped
       to on.

  ti,fiber-mode:
    type: boolean
    description: |
       DP83822 PHY only.
       If present the DP83822 PHY is configured to operate in fiber mode
       Fiber mode support can also be strapped. If the strap pin is not set
       correctly or not set at all then this boolean can be used to enable it.
       If the fiber mode is not strapped then signal detection for the PHY
       is disabled.
       In fiber mode, auto-negotiation is disabled and the PHY can only work in
       100base-fx (full and half duplex) modes.

  rx-internal-delay-ps:
    description: |
       DP83822 PHY only.
       Setting this property to a non-zero number sets the RX internal delay
       for the PHY.  The internal delay for the PHY is fixed to 3.5ns relative
       to receive data.

  tx-internal-delay-ps:
    description: |
       DP83822 PHY only.
       Setting this property to a non-zero number sets the TX internal delay
       for the PHY.  The internal delay for the PHY is fixed to 3.5ns relative
       to transmit data.

  ti,strap-duplex-mode:
    $ref: /schemas/types.yaml#/definitions/uint8
    description: |
       DP83822 PHY only.
       If present and set to a non-zero number, the bootstrap bit for the duplex mode
       is set to full duplex. If present and set to zero, half-duplex is set.

  ti,strap-auto-neg-enable:
    $ref: /schemas/types.yaml#/definitions/uint8
    description: |
       DP83822 PHY only.
       If present and set to a non-zero number, the bootstrap bit for the auto-
       negotiation is enabled. If present and set to zero, auto-negotiation is
       disabled.

  ti,strap-speed-select:
    $ref: /schemas/types.yaml#/definitions/uint8
    description: |
       DP83822 PHY only.
       If present and set to a non-zero number, the bootstrap bit for the speed
       select is set to 100 Mbps. If present and set to zero, 10 Mbps is set.

  ti,strap-advertise-10te-half:
    $ref: /schemas/types.yaml#/definitions/uint8
    description: |
       DP83822 PHY only.
       If present and set to a non-zero number, the bootstrap bit for auto-
       negotiation advertising 10Base-Te half duplex is set. If present and
       set to zero, 10Base-Te half duplex is not advertised.

  ti,strap-advertise-10te-full:
    $ref: /schemas/types.yaml#/definitions/uint8
    description: |
       DP83822 PHY only.
       If present and set to a non-zero number, the bootstrap bit for auto-
       negotiation advertising 10Base-Te full duplex is set. If present and
       set to zero, 10Base-Te full duplex is not advertised.

  ti,strap-advertise-100tx-half:
    $ref: /schemas/types.yaml#/definitions/uint8
    description: |
       DP83822 PHY only.
       If present and set to a non-zero number, the bootstrap bit for auto-
       negotiation advertising 100Base-TX half duplex is set. If present and
       set to zero, 100Base-TX half duplex is not advertised.

  ti,strap-advertise-100tx-full:
    $ref: /schemas/types.yaml#/definitions/uint8
    description: |
       DP83822 PHY only.
       If present and set to a non-zero number, the bootstrap bit for auto-
       negotiation advertising 100Base-TX full duplex is set. If present and
       set to zero, 100Base-TX full duplex is not advertised.

  ti,strap-100base-fx-enable:
    $ref: /schemas/types.yaml#/definitions/uint8
    description: |
       DP83822 PHY only.
       If present and set to a non-zero number, the bootstrap bit for enabling
       100Base-FX (fiber) mode is set. If present and set to zero, fiber mode
       is disabled.

  ti,strap-rmii-clock-select:
    $ref: /schemas/types.yaml#/definitions/uint8
    description: |
       DP83822 PHY only.
       If present and set to a non-zero number, the bootstrap bit for the RMII
       reference clock is set to 50-MHz. If present and set to zero, the reference
       clock is set to 25-MHz.

  ti,strap-rgmii-mode-enable:
    $ref: /schemas/types.yaml#/definitions/uint8
    description: |
       DP83822 PHY only.
       If present and set to a non-zero number, the bootstrap bit for enabling
       RGMII mode is set. If present and set to zero, RGMII mode is disabled.

  ti,strap-led0-polarity:
    $ref: /schemas/types.yaml#/definitions/uint8
    description: |
       DP83822 PHY only.
       If present and set to a non-zero number, the bootstrap bit for LED0 link
       polarity is set to active high. If present and set to zero, the polarity
       is set to active low.

  ti,strap-auto-mdix-enable:
    $ref: /schemas/types.yaml#/definitions/uint8
    description: |
       DP83822 PHY only.
       If present and set to a non-zero number, the bootstrap bit for auto MDIX
       capability is enabled. If present and set to zero, auto MDIX is disabled.
       Note: Auto MDIX is enabled only, if 100Base-FX (fiber) mode is set.

  ti,strap-led-configuration:
    $ref: /schemas/types.yaml#/definitions/uint8
    description: |
       DP83822 PHY only.
       If present and set to a non-zero number the bootstrap bit for LED configuration
       is set to "ON for LINK and OFF for no LINK". If present and set to zero, the
       configuration is set to "ON for LINK and BLINK for TX/RX Activity".

  ti,strap-mled-polarity-swap:
    $ref: /schemas/types.yaml#/definitions/uint8
    description: |
       DP83822 PHY only.
       If present and set to a non-zero number, the bootstrap bit for MLED polarity
       swap is set to active high. If present and set to zero, MLED polarity is set
       to active low.

  ti,strap-eee-capa-enable:
    $ref: /schemas/types.yaml#/definitions/uint8
    description: |
       DP83822 PHY only.
       If present and set to a non-zero number, the bootstrap bit for EEE capabilities
       support is enabled. If present and set to zero, EEE capabilities are disabled.

required:
  - reg

examples:
  - |
    mdio0 {
      #address-cells = <1>;
      #size-cells = <0>;
      ethphy0: ethernet-phy@0 {
        reg = <0>;
        rx-internal-delay-ps = <1>;
        tx-internal-delay-ps = <1>;
      };
    };

...
```
